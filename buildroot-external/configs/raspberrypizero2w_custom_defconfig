## buildroot-external/configs/raspberrypizero2w_custom_defconfig
```kconfig
BR2_aarch64=y
BR2_cortex_a53=y
BR2_ARM_FPU_NEON_VFPV4=y

# Linux headers same as kernel, 6.1 series
BR2_PACKAGE_HOST_LINUX_HEADERS_CUSTOM_6.1=y

BR2_TOOLCHAIN_BUILDROOT_CXX=y

BR2_PACKAGE_RPI_FIRMWARE=y
BR2_PACKAGE_RPI_FIRMWARE_BOOTCODE_BIN=y
BR2_PACKAGE_RPI_FIRMWARE_VARIANT_PI=y
BR2_PACKAGE_RPI_FIRMWARE_CONFIG_FILE="$(BR2_EXTERNAL_CUSTOM_BOARD_PATH)/configs/config_zero2w.txt"

# Required tools to create the SD image
BR2_PACKAGE_HOST_DOSFSTOOLS=y
BR2_PACKAGE_HOST_GENIMAGE=y
BR2_PACKAGE_HOST_MTOOLS=y

# Filesystem / image
BR2_TARGET_ROOTFS_EXT2=y
BR2_TARGET_ROOTFS_EXT2_4=y
BR2_TARGET_ROOTFS_EXT2_SIZE="180M"
# BR2_TARGET_ROOTFS_TAR is not set
BR2_ROOTFS_POST_BUILD_SCRIPT="board/raspberrypizero2w/post-build.sh"

# Enable compressed kernel module support
BR2_PACKAGE_BUSYBOX_SHOW_OTHERS=y
BR2_PACKAGE_KMOD_TOOLS=y
BR2_PACKAGE_XZ=y
BR2_PACKAGE_KMOD=y
BR2_PACKAGE_HOST_KMOD_XZ=y

BR2_ROOTFS_OVERLAY="../rootfs-overlay"
BR2_TARGET_GENERIC_ROOT_PASSWD="root"
BR2_PER_PACKAGE_DIRECTORIES=y
BR2_INIT_SYSTEMD=y
BR2_GCC_VERSION_13_X=y

# Wi-Fi
BR2_PACKAGE_BRCMFMAC_SDIO_FIRMWARE_RPI=y
BR2_PACKAGE_BRCMFMAC_SDIO_FIRMWARE_RPI_WIFI=y
BR2_PACKAGE_IW=y
BR2_PACKAGE_WIRELESS_TOOLS=y
BR2_PACKAGE_WIRELESS_TOOLS_LIB=y
BR2_PACKAGE_WPA_SUPPLICANT=y
BR2_PACKAGE_WPA_SUPPLICANT_NL80211=y
BR2_PACKAGE_WPA_SUPPLICANT_AP_SUPPORT=y
BR2_PACKAGE_WPA_SUPPLICANT_HOTSPOT=y
BR2_PACKAGE_WPA_SUPPLICANT_AUTOSCAN=y
BR2_PACKAGE_WPA_SUPPLICANT_WPA3=y
BR2_PACKAGE_WPA_SUPPLICANT_EAP=y

BR2_PACKAGE_DROPBEAR=y
BR2_PACKAGE_NTP=y
BR2_PACKAGE_LIBCURL_CURL=y
BR2_PACKAGE_OPENSSL=y
BR2_PACKAGE_CA_CERTIFICATES=y
BR2_PACKAGE_NGINX=y
BR2_PACKAGE_LIBGPIOD=y
BR2_PACKAGE_GDB=y
BR2_PACKAGE_HOST_GDB=y

# To extend image on all SD card space
BR2_PACKAGE_E2FSPROGS=y
BR2_PACKAGE_E2FSPROGS_RESIZE2FS=y
BR2_PACKAGE_PARTED=y

# Image upgrade
BR2_PACKAGE_HOST_SWUGENERATOR=y
BR2_PACKAGE_SWUPDATE=y
BR2_PACKAGE_SWUPDATE_USB=y
BR2_PACKAGE_SWUPDATE_CONFIG="$(BR2_EXTERNAL_CUSTOM_BOARD_PATH)/configs/swupdate.config"
BR2_PACKAGE_LIBCONFIG=y
```
